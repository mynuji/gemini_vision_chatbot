## sdkconfig.defaults
```kconfig
CONFIG_ESPTOOLPY_FLASHSIZE_8MB=y
CONFIG_PARTITION_TABLE_CUSTOM=y
CONFIG_PARTITION_TABLE_CUSTOM_FILENAME="partitions.csv"
CONFIG_PARTITION_TABLE_FILENAME="partitions.csv"
CONFIG_PARTITION_TABLE_OFFSET=0x8000
CONFIG_SPIRAM=y
CONFIG_SPIRAM_MODE_OCT=y
CONFIG_SPIRAM_SPEED_80M=y
CONFIG_ESP_DEFAULT_LOG_LEVEL_INFO=y
CONFIG_LOG_DEFAULT_LEVEL_INFO=y
CONFIG_LV_COLOR_16_SWAP=y
CONFIG_SR_WN_WN10_ALEXA=y
CONFIG_ESP_SR_MODEL_IN_FLASH=y
CONFIG_ESP_DEFAULT_CPU_FREQ_MHZ_240=y
CONFIG_ESP_DEFAULT_CPU_FREQ_MHZ=240
CONFIG_SPIRAM_TRY_ALLOCATE_WIFI_LWIP=y
CONFIG_LWIP_TCP_SND_BUF_DEFAULT=14400
CONFIG_LWIP_TCP_WND_DEFAULT=14400
CONFIG_LWIP_TCP_RECVMBOX_SIZE=16
CONFIG_ESP_TASK_WDT_CHECK_IDLE_TASK_CPU1=n
# CONFIG_CAMERA_PSRAM_DMA is not set
CONFIG_CAMERA_DMA_BUFFER_SIZE_MAX=16384
CONFIG_CAMERA_TASK_STACK_SIZE=3072
```
